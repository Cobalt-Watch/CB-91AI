## firmware/boards/cobalt/cb91ai/Kconfig
```kconfig
# Copyright (c) 2026 COBALT Technologies
# SPDX-License-Identifier: Apache-2.0

if BOARD_CB91AI

config CB91AI_PROVISION_UICR
	bool "Program UICR at first boot (REGOUT0 = 3.0 V, debug port kept open)"
	default y
	help
	  VDD of the nRF52840 is fed by the coin cell while VDDH is fed by USB.
	  When USB is plugged the chip enters high voltage mode and REG0 drives
	  the 3V rail at the voltage stored in UICR.REGOUT0, whose factory value
	  is 1.8 V. This option programs REGOUT0 to 3.0 V and, on revision 3 or
	  later dies only (build code F and up, hardened APPROTECT), sets
	  UICR.APPROTECT to HwDisabled (0x5A) so that the SWD port stays open.
	  On older dies (build codes up to D, legacy APPROTECT) UICR.APPROTECT
	  is left erased, which is the only value keeping the port open there.
	  The chip is reset once after programming.

endif # BOARD_CB91AI
```

## firmware/boards/cobalt/cb91ai/Kconfig.cb91ai
```kconfig
# Copyright (c) 2026 COBALT Technologies
# SPDX-License-Identifier: Apache-2.0

config BOARD_CB91AI
	select SOC_NRF52840_QIAA
```

## firmware/boards/cobalt/cb91ai/Kconfig.defconfig
```kconfig
# Copyright (c) 2026 COBALT Technologies
# SPDX-License-Identifier: Apache-2.0

if BOARD_CB91AI

config HW_STACK_PROTECTION
	default ARCH_HAS_STACK_PROTECTION

if NORDIC_QSPI_NOR

config NORDIC_QSPI_NOR_FLASH_LAYOUT_PAGE_SIZE
	default 4096 if MCUBOOT || BOOTLOADER_MCUBOOT

endif # NORDIC_QSPI_NOR

endif # BOARD_CB91AI
```

## firmware/boards/cobalt/cb91ai/board.yml
```yaml
board:
  name: cb91ai
  full_name: COBALT CB-91AI
  vendor: cobalt
  socs:
    - name: nrf52840
```

## firmware/lib/Kconfig
```kconfig
# Copyright (c) 2026 COBALT Technologies
# SPDX-License-Identifier: Apache-2.0
#
# Shared library of the CB-91AI (lot D1). These options say what an application
# links; its own behaviour stays in its own Kconfig.

menu "CB-91AI shared library"

config CB91AI_LIB_LCD
	bool "LCD driver (BU97930 and the F-91W glass)"
	help
	  lcd.c: framebuffer, segment tables of the glass, bias mode, software
	  standby of the driver. Says nothing about what to display.

if CB91AI_LIB_LCD

config CB91AI_LCD_GLASS_COM2_ON_COM0
	bool "Glass COM2 plot bridged to the driver COM0 output (V1 rework)"
	default y
	help
	  On the V1 board the third COM plot of the F-91W glass (plot 9) is
	  wired to the driver SEG2 output. The rework of V2-31 bridges plot 9
	  to plot 6 (driver COM0) and cuts the SEG2 trace, and the Sensor Watch
	  COM2 pixels are then written to driver COM0. Every V1 board in use
	  carries this rework (and the DEC4-DEC6 wire of V2-32), hence the
	  default; set to n for an untouched V1 board.
	  `cb91ai lcd com2 on|off` toggles it at run time.

endif # CB91AI_LIB_LCD

config CB91AI_LIB_MIC
	bool "PDM microphone capture"
	help
	  mic.c: supply, PDM at 16 kHz, high-pass of the capture path, gain.

if CB91AI_LIB_MIC

config CB91AI_MIC_GAIN_DB
	int "Microphone gain around the default of the PDM peripheral, in dB"
	range -20 20
	default 0
	help
	  Starting value of mic_set_gain_db(), `cb91ai mic gain <dB>` at run
	  time. Measured on the bare V1 board on 2026-09-20: at +6 dB a loud voice
	  10 to 15 cm away clips, while a quiet one at 30 cm peaks 27 dB below
	  full scale, 30 dB between the two. A low level costs nothing with a
	  floating-point codec and clipping cannot be undone: keep 0 until the
	  level is known with the board in its case.

config CB91AI_MIC_HIGH_PASS_HZ
	int "Corner frequency of the high-pass of the capture path, in Hz"
	range 10 300
	default 50
	help
	  The output of the microphone drifts for more than three seconds after
	  power-up; a first-order high-pass at 50 Hz brings the first half second
	  of a capture back to the noise floor (lib/mic.c).

endif # CB91AI_LIB_MIC

config CB91AI_LIB_ACCEL
	bool "BMA400 accelerometer"
	help
	  accel.c: reading, temperature, and later the wake-up interrupts.

config CB91AI_LIB_CLOCK
	bool "Wall clock corrected for the crystal, kept across resets"
	help
	  clock.c: UTC anchored on the uptime, correction in ppb, automatic
	  calibration on a host time, time kept in retained RAM across a reset,
	  12 or 24 hour display.

if CB91AI_LIB_CLOCK

config CB91AI_CLOCK_DEFAULT_PPB
	int "Default error of the 32.768 kHz crystal, in parts per billion"
	default 0
	range -1000000 1000000
	help
	  Positive when the crystal runs fast. Starting value of the wall clock
	  correction (lib/clock.c) until the watch has calibrated itself on the
	  time settings of its host. Measured with firmware/tools/lfxo_drift.py;
	  the V1 boards share the same undersized load capacitors (V2-02), so
	  one value suits them all within the +/-20 ppm of the crystals.

config CB91AI_CLOCK_24H
	bool "24-hour display by default"
	default n
	help
	  Default format of the displayed time, until the user picks one (stored
	  in the settings, `cb91ai time format 12|24`, later the phone app).
	  12-hour on the V1 board: the plot that carries segments A, D, E and F
	  of the hour tens (glass SEG18) cannot be driven there (V2-31), so that
	  position only shows "1" or nothing, which is all a 12-hour clock asks
	  of it; "2" for 20 to 23 h cannot be drawn. Set to y for the V2 board.

endif # CB91AI_LIB_CLOCK

config CB91AI_LIB_GESTURE
	bool "Gestures of the case buttons"
	help
	  gesture.c (lot D3): debounce, clicks, long press and chords of the
	  buttons as a pure state machine, with the timings of the V1 (EF-17).
	  No Zephyr inside: firmware/tests/host builds it for the PC. Says
	  nothing about what a gesture does.

config CB91AI_LIB_CALENDAR
	bool "Civil calendar"
	help
	  calendar.c: milliseconds since 1970 to date and time and back, in
	  pure C, checked on the PC against the C library of the host on every
	  day from 1900 to 2200 (firmware/tests/host).

config CB91AI_LIB_VAD
	bool "Voice activity: the end of a take after 3 s without speech"
	help
	  vad.c (lot E1): the level of each 10 ms frame against a noise floor
	  that rises 1 dB a second, runs of loud frames as speech, in pure C
	  without floating point, checked on the PC on made-up signals and on
	  the sentences of K1 (firmware/tests/host/test_vad.c).

config CB91AI_LIB_NOTE
	bool "The voice note container v2"
	help
	  note.c (lot E1): the header of 64 bytes of the Cobalt Link specification
	  section 4 written and read byte for byte, the CRC32 of IEEE 802.3
	  and its combination, in pure C, checked on the PC.

config CB91AI_LIB_LINK_PROTO
	bool "Messages of the Cobalt Link service"
	help
	  link_proto.c (lot D6): the messages of the Cobalt Link specification
	  section 3.1, written and parsed byte for byte, in pure C, checked
	  on the PC against the vectors that the PC harness checks too
	  (firmware/tests/vectors/link_v1.txt).

endmenu
```

## firmware/lib/dts/bindings/bosch,bma400.yaml
```yaml
# Copyright (c) 2026 COBALT Technologies
# SPDX-License-Identifier: Apache-2.0

description: Bosch BMA400 ultra-low-power 3-axis accelerometer on I2C (no in-tree driver yet)

compatible: "bosch,bma400"

include: i2c-device.yaml

properties:
  int1-gpios:
    type: phandle-array
    description: INT1 output of the sensor
  int2-gpios:
    type: phandle-array
    description: INT2 output of the sensor
```

## firmware/lib/dts/bindings/cobalt,pwm-buzzer.yaml
```yaml
# Copyright (c) 2026 COBALT Technologies
# SPDX-License-Identifier: Apache-2.0

description: Magnetic or piezo buzzer driven by a PWM output through a transistor

compatible: "cobalt,pwm-buzzer"

include: base.yaml

properties:
  pwms:
    type: phandle-array
    required: true
    description: PWM channel driving the buzzer. The period sets the tone.
```

## firmware/lib/dts/bindings/rohm,bu97930.yaml
```yaml
# Copyright (c) 2026 COBALT Technologies
# SPDX-License-Identifier: Apache-2.0

description: ROHM BU97930 segment LCD driver, 3-wire write-only SPI (CSB, SCL, SD)

compatible: "rohm,bu97930"

include: spi-device.yaml
```

## firmware/modules/opus/Kconfig
```kconfig
# Copyright (c) 2026 COBALT Technologies
# SPDX-License-Identifier: Apache-2.0

config CB91AI_OPUS
	bool "Opus encoder (libopus, fixed point)"
	help
	  Builds libopus for the watch: fixed point (no FPU needed), no float
	  API, scratch memory on the stack of the calling thread. The decoder
	  is compiled too, and dropped by the linker when nothing calls it.

	  The sources of libopus (BSD licence) are not in this repository.
	  Clone https://github.com/xiph/opus (tag v1.5.2) and say where it is
	  with the CB91AI_OPUS_DIR environment variable or CMake variable;
	  default: modules/lib/opus of the west workspace.

if CB91AI_OPUS

config CB91AI_OPUS_ARM_INLINE_ASM
	bool "ARMv7E-M inline assembly of libopus (DSP multiplies)"
	default y
	help
	  OPUS_ARM_INLINE_ASM, _EDSP and _MEDIA: the 16 x 32 and 16 x 16
	  multiplies of the fixed-point code become SMULWB, SMLAWB and the
	  like, saturation becomes SSAT, all of which the Cortex-M4 has. The
	  separate ARM assembly files of libopus are for A-profile cores and
	  are not built. Same output, bit for bit, as the C code (the bench
	  prints a CRC of the encoded stream to check it).

choice CB91AI_OPUS_OPTIMIZATION
	prompt "Compiler optimization of libopus"
	default CB91AI_OPUS_O2

config CB91AI_OPUS_O2
	bool "-O2: speed"

config CB91AI_OPUS_OS
	bool "-Os: size"

endchoice

endif # CB91AI_OPUS
```
