## CMakeLists.txt
```
# Copyright (c) 2026 COBALT Technologies
# SPDX-License-Identifier: Apache-2.0
#
# The watch: the product application. The bench
# self-test lives next door in firmware/app and stays a bench tool.

cmake_minimum_required(VERSION 3.20.0)

# Board definition and shared drivers, both shared with the self-test
get_filename_component(CB91AI_FIRMWARE_DIR ${CMAKE_CURRENT_SOURCE_DIR}/.. ABSOLUTE)
list(APPEND BOARD_ROOT ${CB91AI_FIRMWARE_DIR})
list(APPEND ZEPHYR_EXTRA_MODULES ${CB91AI_FIRMWARE_DIR}/lib)
# The bindings of the board's parts live with their drivers (firmware/lib/dts)
list(APPEND DTS_ROOT ${CB91AI_FIRMWARE_DIR}/lib)

# The VERSION file drives the version MCUboot compares, and Zephyr turns it into
# APP_VERSION_STRING (app_version.h). The Firmware Revision of the Device
# Information Service takes it too (EF-64): a Kconfig fragment written at
# configure time, as in the self-test, so that a phone reads over Bluetooth the
# very version MCUboot and MCUmgr report. The two applications share one line of
# versions on a board: MCUboot only compares numbers.
file(READ ${CMAKE_CURRENT_SOURCE_DIR}/VERSION app_version_file)
string(REGEX MATCH "VERSION_MAJOR = ([0-9]+)" _ "${app_version_file}")
set(app_version_major ${CMAKE_MATCH_1})
string(REGEX MATCH "VERSION_MINOR = ([0-9]+)" _ "${app_version_file}")
set(app_version_minor ${CMAKE_MATCH_1})
string(REGEX MATCH "PATCHLEVEL = ([0-9]+)" _ "${app_version_file}")
set(app_version_patch ${CMAKE_MATCH_1})
file(WRITE ${CMAKE_CURRENT_BINARY_DIR}/version.conf
     "CONFIG_BT_DIS_FW_REV_STR=\"${app_version_major}.${app_version_minor}.${app_version_patch}\"\n")
list(APPEND EXTRA_CONF_FILE ${CMAKE_CURRENT_BINARY_DIR}/version.conf)
set_property(DIRECTORY APPEND PROPERTY CMAKE_CONFIGURE_DEPENDS ${CMAKE_CURRENT_SOURCE_DIR}/VERSION)

# Images signed with the address of their slot in the header (direct execution)
set(SIGNING_SCRIPT ${CMAKE_CURRENT_SOURCE_DIR}/cmake/sign.cmake)

find_package(Zephyr REQUIRED HINTS $ENV{ZEPHYR_BASE})
project(cb91ai_watch LANGUAGES C)

target_sources(app PRIVATE src/main.c src/events.c src/buttons.c src/ui.c src/radio.c
			   src/link.c src/session.c src/update.c src/power.c src/light.c src/led.c
			   src/store.c src/tlog.c src/notes.c src/recorder.c src/take.c src/pair.c
			   src/pairing.c src/recall.c src/clicks.c src/wrist.c src/stuck.c src/cell.c
			   src/counts.c src/counters.c src/daily.c src/look.c)
# update.c reads the upload's offset and size from the image group's structures
# (img_mgmt.h), whose MCUboot headers need its configuration, as Zephyr's own
# libraries that use them link it
if(TARGET MCUBOOT_BOOTUTIL)
  target_link_libraries(app PRIVATE MCUBOOT_BOOTUTIL)
endif()
# The status line and the time of the bench tools, development build only
target_sources_ifdef(CONFIG_CB91AI_WATCH_DEBUG_SERVICE app PRIVATE src/debug.c)
```

## Kconfig
```
# Copyright (c) 2026 COBALT Technologies
# SPDX-License-Identifier: Apache-2.0
#
# Behaviour of the watch application. The drivers it links are chosen in
# firmware/lib/Kconfig.

config CB91AI_WATCH_DISPLAY_SECONDS
	int "How long the display stays lit after a wake-up, in seconds"
	default 10
	range 1 15
	help
	  EF-44: the display is the first item of the energy budget, so it is
	  lit on demand and goes back to standby by itself.

config CB91AI_WATCH_ADV_ALWAYS
	bool "Advertise all the time, slowly (development)"
	help
	  In Cobalt Link, the product keeps its radio
	  silent and advertises for a reason only (a note, a sync by hand).
	  The development build advertises for good, fast for 30 s after
	  boot, a disconnection or a call, slow (1 s) otherwise, as the
	  self-test does: the PC then always finds a sealed watch.

config CB91AI_WATCH_LINK_OPEN
	bool "Cobalt Link without pairing (development)"
	help
	  The service is meant for an encrypted, authenticated link only
	  (the Cobalt Link specification). Until the pairing of phase
	  S exists, the development build opens it, as SMP is open.

config CB91AI_WATCH_DEBUG_SERVICE
	bool "Debug service: status line and time (development)"
	help
	  The status line and the time characteristic of the self-test, with
	  its UUIDs, so that ble_update.py and cobalt_time.py work on the
	  watch as they are (src/debug.c).

config CB91AI_WATCH_DEBUG_TAKE
	bool "Takes started by the PC harness (development)"
	help
	  Cobalt Link key 0x7F: a take of a set length, without the voice
	  detector, as if ALARM had been held, so that the harness checks the
	  whole chain on a sealed watch, a hundred notes in a row
	  (tools/cobalt_link.py hundred). Never in the product.

config CB91AI_WATCH_DEBUG_JOURNAL
	bool "The journal's period set by the PC harness (development)"
	help
	  Cobalt Link key 0x7D: the period of the journal of the temperature
	  and the cell (lot T1), 1 to 600 s until the next boot, so that the
	  harness fills pages and sectors in minutes
	  (tools/cobalt_link.py --period 5 journal). Never in the product.

config CB91AI_WATCH_DEBUG_DAILY
	bool "The daily call's period set by the PC harness (development)"
	help
	  Cobalt Link key 0x7E: the period of the daily call (the watch calls
	  the phone after a day without any contact), 60 to 86400 s until the
	  next boot, so that the harness sees it come in minutes
	  (tools/cobalt_link.py --daily 60 daily). Never in the product.

config CB91AI_WATCH_DEBUG_TRIAL
	bool "The trial of the calls (development, lot N1a)"
	depends on CB91AI_WATCH_ADV_ALWAYS
	help
	  Cobalt Link key 0x7A: for a time the phone or the harness sets, the
	  radio behaves as the product's, silent between its calls, and the
	  watch times each call from its first advertisement to the connection
	  of the phone, which reads it back: how fast a phone comes back in the
	  background (risk R11, app/android probe, tools/cobalt_link.py trial).
	  Never in the product.

config CB91AI_WATCH_DEBUG_WRIST
	bool "The wrist's tuning set by the PC harness (development)"
	help
	  Cobalt Link key 0x7C: the thresholds of the accelerometer for the
	  raise of the wrist and the double tap (lot D4), read and set again
	  at once, so that they are tuned at the wrist without a new image
	  (tools/cobalt_link.py wrist). Never in the product.

config CB91AI_WATCH_DEBUG_PASSKEY
	int "A fixed pairing code for the bench (development), 0: drawn at random"
	default 0
	range 0 99999
	help
	  The code of a pairing, shown on the glass as always, fixed instead
	  of drawn from the hardware generator: the PC of the bench pairs with
	  no one to read the glass (tools/ble_pair.py, lot S2), then installs
	  and tries a product image, whose SMP and Cobalt Link ask for the
	  authenticated link. Never in the product: its code is drawn at
	  random at every pairing, and read on the glass.

config CB91AI_WATCH_NOTE_MAX_S
	int "The longest take, in seconds"
	default 120
	range 10 300
	help
	  A take held past half a second shows "rEC" and runs on by itself
	  until a press of ALARM (2026-09-24), 3 s after the last
	  word, or this long. The voice goes straight to the 1 MB storage
	  flash, about 8 min of LC3 at 16 kbit/s in all: the 15 s of EF-23
	  came from the RAM of the V1. The watch keeps this much erased ahead
	  of the notes (59 sectors of 4 KB for 120 s), hence the bound.

config CB91AI_WATCH_CONFIRM_WAIT_S
	int "How long an image in test waits for its confirmation, in seconds"
	default 600
	range 120 3600
	help
	  The watch never confirms itself: the host confirms a new image over
	  SMP once it finds it running, which proves the way back works. An
	  image still in test after this long reboots, and MCUboot starts the
	  previous one again (src/update.c).

source "Kconfig.zephyr"
```

## Kconfig.sysbuild
```
# Copyright (c) 2026 COBALT Technologies
# SPDX-License-Identifier: Apache-2.0
#
# Sysbuild configuration root of the CB-91AI firmware.
#
# The key that signs the images never lives in this repository (open source:
# no secret here, ever). Its path comes from the environment:
#
#     set CB91AI_SIGNING_KEY=C:/Users/<you>/.cobalt/keys/cb91ai-signing-rsa2048.pem
#
# with forward slashes. MCUboot embeds the public half, and the application
# image is signed with the private one. Without the variable, sysbuild falls
# back to the development key shipped with MCUboot, which everyone has: fine to
# try the code on a board of your own, refused by a watch that carries the
# project bootloader. sysbuild.cmake says which key a build uses.

config BOOT_SIGNATURE_KEY_FILE
	string
	default "$(CB91AI_SIGNING_KEY)" if "$(CB91AI_SIGNING_KEY)" != ""

source "share/sysbuild/Kconfig"
```

## sysbuild.conf
```
# Build MCUboot together with the application and sign the application image.
SB_CONFIG_BOOTLOADER_MCUBOOT=y
# Direct execution with revert (2026-09-20): the new image runs from the slot it
# was uploaded to, MCUboot copies nothing. An update used to end with 28 s of
# swap, the largest item of its 50 s and some 50 uAh of a coin cell. Same safety
# net as a swap: an image marked for test runs once, and is erased at the next
# reset unless it confirmed itself (EF-62). What it costs: one variant of the
# image per slot, built by sysbuild (app and app_slot1_variant), a version that
# must grow with each update (MCUboot starts the higher one), no way back to an
# older version.
SB_CONFIG_MCUBOOT_MODE_DIRECT_XIP_WITH_REVERT=y
# RSA-2048. The key file comes from the environment (CB91AI_SIGNING_KEY, see
# Kconfig.sysbuild), never from this repository; without it, the development
# key shipped with MCUboot (root-rsa-2048.pem), with which anyone can sign.
SB_CONFIG_BOOT_SIGNATURE_TYPE_RSA=y
```

## prj.conf
```kconfig
# The watch: the product application.
#
# What is not here, on purpose, and which the bench self-test carries instead:
# the shell, USB, the diagnostic commands. Two build variants on top of this
# one (EF-70): debug.conf and release.conf.

# --- Shared library (firmware/lib) ---
CONFIG_CB91AI_LIB_LCD=y
CONFIG_CB91AI_LIB_CLOCK=y
# The gestures of the case buttons (lot D3), a pure state machine
CONFIG_CB91AI_LIB_GESTURE=y
# Date and time by hand in the settings (ui.c), checked on the PC
CONFIG_CB91AI_LIB_CALENDAR=y
# The voice (lot E1): the microphone, the end of a take on silence, the note
# container. The accelerometer: put to sleep at boot (0.2.1+9 to +11 woke it
# for its thermometer); its motion comes with D4.
CONFIG_CB91AI_LIB_MIC=y
# 6 dB under the PDM's default since 0.2.1+31: a voice clipped when spoken
# close to the watch (a note of 2026-09-29, at -10 dBFS of speech), and the
# phone's recognizer lost its words; the detector's floor
# follows the gain (vad_set_gain_db)
CONFIG_CB91AI_MIC_GAIN_DB=-6
CONFIG_CB91AI_LIB_VAD=y
CONFIG_CB91AI_LIB_NOTE=y
CONFIG_CB91AI_LIB_ACCEL=y
CONFIG_I2C=y
# The thermometer of the "tE P" screen: the nRF52840's own (TEMP, through
# Zephyr's driver), the choice after the test of 2026-09-25
CONFIG_SENSOR=y

# --- Peripherals of the display and of the wall clock ---
CONFIG_GPIO=y
CONFIG_SPI=y
CONFIG_REGULATOR=y
CONFIG_HWINFO=y
CONFIG_REBOOT=y
CONFIG_CLOCK_CONTROL=y

# The wall clock keeps its correction in the settings and its time in retained
# RAM, at a fixed address of the board devicetree (lib/clock.c)
CONFIG_SETTINGS=y
CONFIG_SETTINGS_NVS=y
CONFIG_NVS=y
CONFIG_FLASH=y
CONFIG_FLASH_MAP=y
CONFIG_RETAINED_MEM=y
CONFIG_RETENTION=y
# +137.9 ppm measured on the V1 boards (tools/lfxo_drift.py); each watch then
# refines its own value on the time its phone gives it
CONFIG_CB91AI_CLOCK_DEFAULT_PPB=138000

# 12-hour by default on the V1: its hour tens can only draw "1" (V2-31)
CONFIG_CB91AI_CLOCK_24H=n
CONFIG_CB91AI_LCD_GLASS_COM2_ON_COM0=y

# --- Watchdog ---
# Started first thing in main(), fed last thing before a software reset. The
# hardware window is MIN_TIMEOUT + HW_FALLBACK_DELAY and only changes at a
# hardware reset: never feed less often than the shortest window ever shipped
# (4 s since 0.1.21).
CONFIG_WATCHDOG=y
CONFIG_TASK_WDT=y
CONFIG_TASK_WDT_MIN_TIMEOUT=3000
CONFIG_TASK_WDT_HW_FALLBACK_DELAY=1000

# --- Idle consumption ---
CONFIG_PM_DEVICE=y
CONFIG_PM_DEVICE_RUNTIME=y

CONFIG_MAIN_STACK_SIZE=4096
# The log mode is the development build's (debug.conf); the product has no log
CONFIG_LOG=y

# --- The cell (src/power.c): the VDD input of the SAADC ---
CONFIG_ADC=y

# --- The RGB LED (src/led.c): the light of LIGHT, the blink of a take, the
# verdict of the app, on the three PWM channels of pwm0 ---
CONFIG_PWM=y

# --- The voice notes (lot E1, src/recorder.c, src/notes.c) ---
# The PDM microphone through the dmic API, as in the self-test; LC3 at
# 16 kbit/s (K3), which computes in floating point: the FPU, shared since the
# audio thread is not the only one the compiler may give FP registers to, and
# a full C library (picolibc). The notes fill the 1 MB QSPI flash, which the
# driver puts in deep power-down between accesses.
CONFIG_AUDIO=y
CONFIG_AUDIO_DMIC=y
CONFIG_FPU=y
CONFIG_FPU_SHARING=y
CONFIG_LIBLC3=y
CONFIG_NORDIC_QSPI_NOR=y

# --- Bluetooth LE (lot D6, src/radio.c, src/link.c) ---
# The settings of the self-test (app/prj.conf), which the bench validated: one
# connection, 0 dBm (EF-31), the 250 ppm sleep clock of the V1 (EF-39), large
# packets and 2M PHY for the updates and the notes.
CONFIG_BT=y
CONFIG_BT_PERIPHERAL=y
CONFIG_BT_DEVICE_NAME="CB-91AI"
# The name of each watch, given by the phone (Cobalt Link key 0x06): 11
# characters at most, what fits in the scan response next to the UUID of SMP;
# the host keeps it in the settings ("bt/name"), "CB-91AI" until then
CONFIG_BT_DEVICE_NAME_DYNAMIC=y
CONFIG_BT_DEVICE_NAME_MAX=11
CONFIG_BT_DEVICE_APPEARANCE=192
CONFIG_BT_MAX_CONN=1
CONFIG_BT_BAS=y
CONFIG_BT_DIS=y
CONFIG_BT_DIS_MODEL_NUMBER_STR="CB-91AI"
CONFIG_BT_DIS_MANUF_NAME_STR="COBALT"
# The revision string comes from the VERSION file, see CMakeLists.txt (EF-64)
CONFIG_BT_DIS_FW_REV=y
CONFIG_BT_DIS_HW_REV=y
CONFIG_BT_DIS_HW_REV_STR="V1"
CONFIG_BT_CTLR_TX_PWR_0=y
CONFIG_BT_CTLR_TX_PWR_DYNAMIC_CONTROL=y
CONFIG_CLOCK_CONTROL_NRF_K32SRC_250PPM=y
CONFIG_BT_L2CAP_TX_MTU=498
CONFIG_BT_BUF_ACL_TX_SIZE=251
CONFIG_BT_BUF_ACL_RX_SIZE=502
CONFIG_BT_CTLR_DATA_LENGTH_MAX=251
CONFIG_BT_AUTO_PHY_PERIPHERAL_2M=y
# The watch asks for a larger MTU at once: a note goes in notifications of
# MTU - 4 bytes (the Cobalt Link specification)
CONFIG_BT_GATT_CLIENT=y
CONFIG_BT_GATT_AUTO_UPDATE_MTU=y
# Connection parameters within Apple's rules (interval of 15 ms at least):
# 15 to 30 ms, and a supervision timeout of
# 4 s from the start of the link (lot B5: 420 ms lost the link during a slot
# erase), asked 5 s after the connection. A latency of 30 (Cobalt Link,
# since 0.2.1+21): the watch skips the events
# where it has nothing to send, listening about once a second while it waits
# for the phone, and sends at every event as soon as it has data (the
# controller cancels the latency); Apple's rules hold (30 ms x 31 <= 2 s, and
# 4 s > 3 x 930 ms). MCUmgr asks for its own, latency 0, while an update runs,
# and gives these back 5 s after its last command.
CONFIG_BT_PERIPHERAL_PREF_MIN_INT=12
CONFIG_BT_PERIPHERAL_PREF_MAX_INT=24
CONFIG_BT_PERIPHERAL_PREF_LATENCY=30
CONFIG_BT_PERIPHERAL_PREF_TIMEOUT=400

# --- Updates over SMP (lot D6, src/update.c) ---
# As in the self-test: MCUmgr over Bluetooth, direct execution with revert
# (sysbuild.conf), images linked for their slot and refused in the other one,
# versions compared down to the build number, partial erase of the internal
# flash so that the radio keeps its link during the erase of a slot (lot B5).
# The parameters asked during a transfer keep within Apple's rules too: iOS
# refused the 7.5 ms of the defaults on 2026-09-21 (lot B4).
CONFIG_NET_BUF=y
CONFIG_ZCBOR=y
CONFIG_CRC=y
CONFIG_MCUMGR=y
CONFIG_MCUMGR_TRANSPORT_BT=y
CONFIG_MCUMGR_TRANSPORT_BT_REASSEMBLY=y
CONFIG_MCUMGR_TRANSPORT_BT_CONN_PARAM_CONTROL=y
CONFIG_MCUMGR_TRANSPORT_BT_CONN_PARAM_CONTROL_MIN_INT=12
CONFIG_MCUMGR_TRANSPORT_BT_CONN_PARAM_CONTROL_MAX_INT=24
CONFIG_MCUMGR_TRANSPORT_BT_CONN_PARAM_CONTROL_TIMEOUT=400
CONFIG_MCUMGR_TRANSPORT_NETBUF_SIZE=2475
CONFIG_MCUMGR_GRP_OS=y
CONFIG_MCUMGR_GRP_OS_BOOTLOADER_INFO=y
CONFIG_MCUMGR_GRP_OS_MCUMGR_PARAMS=y
CONFIG_MCUMGR_GRP_IMG=y
CONFIG_IMG_MANAGER=y
CONFIG_MCUBOOT_GENERATE_CONFIRMED_IMAGE=y
CONFIG_MCUMGR_GRP_IMG_REJECT_DIRECT_XIP_MISMATCHED_SLOT=y
CONFIG_MCUMGR_GRP_IMG_VERSION_CMP_USE_BUILD_NUMBER=y
CONFIG_STREAM_FLASH=y
CONFIG_SOC_FLASH_NRF_PARTIAL_ERASE=y
# Hooks: host activity (idle disconnect, session), no upload while this image
# is in test (its way back is the other slot), the reset (update.c)
CONFIG_MCUMGR_MGMT_NOTIFICATION_HOOKS=y
CONFIG_MCUMGR_SMP_COMMAND_STATUS_HOOKS=y
CONFIG_MCUMGR_GRP_IMG_UPLOAD_CHECK_HOOK=y
CONFIG_MCUMGR_GRP_OS_RESET_HOOK=y
# The system work queue runs the Bluetooth TX path, and here the Cobalt Link
# notifications too (link.c): 3 KB, 2304 B in the self-test. Measured over SMP
# with ble_update.py --tasks (debug.conf).
CONFIG_SYSTEM_WORKQUEUE_STACK_SIZE=3072

# --- The Cobalt Link messages and the session (lot D6) ---
CONFIG_CB91AI_LIB_LINK_PROTO=y

# --- Pairing (lot S1, src/pair.c, src/pairing.c) ---
# LE Secure Connections only, authenticated: the watch shows a passkey of five
# digits that the phone types (the application gives it, under 100 000, from
# the hardware generator); a single bond, kept in the settings; a pairing
# accepted only on a watch that holds none (2026-09-24).
# An exception to the rule on flash writes in Bluetooth callbacks:
# the host writes the bond itself, in its RX thread, once per pairing (the
# subscriptions later go through the system work queue). Hence 2 KB for that
# thread instead of 1.2, to be measured after a pairing (ble_update.py --tasks).
CONFIG_BT_SMP=y
CONFIG_BT_SMP_SC_ONLY=y
CONFIG_BT_BONDING_REQUIRED=y
CONFIG_BT_MAX_PAIRED=1
CONFIG_BT_APP_PASSKEY=y
CONFIG_BT_SMP_APP_PAIRING_ACCEPT=y
CONFIG_BT_SETTINGS=y
CONFIG_BT_RX_STACK_SIZE=2048
```

## debug.conf
```kconfig
# The watch, bench variant (EF-70): what helps on the bench and never ships.
#
#   west build ... -s <repo>/firmware/watch -- -DEXTRA_CONF_FILE=debug.conf
#
# Log and shell over RTT (the board has no UART pads), advertising kept slow but
# permanent so that the watch stays reachable from the PC without a gesture,
# Cobalt Link open until the pairing of phase S, and the debug service of the
# bench tools (status line, time).

CONFIG_LOG_MODE_DEFERRED=y
CONFIG_SHELL=y
CONFIG_SHELL_BACKEND_RTT=y
CONFIG_SHELL_PROMPT_RTT="watch:~$ "
CONFIG_SHELL_BACKEND_SERIAL=n
CONFIG_SEGGER_RTT_BUFFER_SIZE_UP=4096
# Stale unread data of the previous run would otherwise swallow the boot log
CONFIG_SEGGER_RTT_INIT_MODE_ALWAYS=y
# The RTT shell polls its input from a timer; the default of 10 ms wakes the
# core a hundred times a second for a console that is rarely attached
CONFIG_SHELL_RTT_RX_POLL_PERIOD=250
CONFIG_KERNEL_SHELL=y

CONFIG_CB91AI_WATCH_ADV_ALWAYS=y
CONFIG_CB91AI_WATCH_LINK_OPEN=y
CONFIG_CB91AI_WATCH_DEBUG_SERVICE=y
# SMP open, as Cobalt Link is: the pairing (S1) would otherwise make MCUmgr ask
# for an authenticated link by default, and ble_update.py could no longer
# confirm or reset the watch. Checked in the .config before every upload.
CONFIG_MCUMGR_TRANSPORT_BT_PERM_RW=y
# Takes started by the harness, for the notes on a sealed watch (lot E1)
CONFIG_CB91AI_WATCH_DEBUG_TAKE=y
# The journal's period set by the harness, for its tests in minutes (lot T1)
CONFIG_CB91AI_WATCH_DEBUG_JOURNAL=y
# The wrist's thresholds tuned by the harness at the wrist (lot D4)
CONFIG_CB91AI_WATCH_DEBUG_WRIST=y
# The daily call's period set by the harness, for its test in minutes
CONFIG_CB91AI_WATCH_DEBUG_DAILY=y
# The trial of the calls: the radio as the product's for a while, each call
# timed to the phone's connection (lot N1a, risk R11)
CONFIG_CB91AI_WATCH_DEBUG_TRIAL=y
# A fixed pairing code, so that the bench pairs alone (tools/ble_pair.py, S2);
# the product draws it at random at every pairing
CONFIG_CB91AI_WATCH_DEBUG_PASSKEY=91091

# The stack used by each thread, over SMP (tools/ble_update.py --tasks): a
# sealed watch gives no other way to measure it. Each reading walks the threads
# with interrupts locked, their stacks byte by byte (about 1 ms): now and then,
# never in a loop.
CONFIG_MCUMGR_GRP_OS_TASKSTAT=y
CONFIG_MCUMGR_GRP_OS_TASKSTAT_STACK_INFO=y
```

## release.conf
```kconfig
# The watch, product variant (EF-70): nothing that only serves the bench.
#
#   west build ... -s <repo>/firmware/watch -- -DEXTRA_CONF_FILE=release.conf
#
# No shell, no console, no log: on a sealed watch the only window is the status
# the link reports (EF-73), and every kilobyte and every wake-up counts.

CONFIG_LOG=n
CONFIG_SHELL=n
CONFIG_CONSOLE=n
CONFIG_USE_SEGGER_RTT=n
CONFIG_RTT_CONSOLE=n
CONFIG_BOOT_BANNER=n
# Keep the assertions off: a watch that stops is worse than one that carries on
CONFIG_ASSERT=n

# Updates from the paired phone only (lots S1 and S2): SMP needs an encrypted,
# authenticated link, as Cobalt Link does (the Cobalt Link specification)
CONFIG_MCUMGR_TRANSPORT_BT_PERM_RW_AUTHEN=y
```

## src/buttons.c
```c
/*
 * Copyright (c) 2026 COBALT Technologies
 * SPDX-License-Identifier: Apache-2.0
 *
 * The case buttons of the watch (lot D3), see buttons.h.
 *
 * Every edge of every button, through the SENSE mechanism of the GPIO port
 * (no clock runs for it), posts EVT_BUTTON_EDGE, once until the loop has taken
 * it: a bouncing contact makes a burst of edges, and the loop reads the levels
 * anyway. The loop feeds them to the gesture machine, which gives the
 * gestures and says when it wants to look again; a one-shot timer posts the
 * same event then. Nothing polls, and the core sleeps between two presses
 * (ENF-03).
 */

#include <zephyr/kernel.h>
#include <zephyr/drivers/gpio.h>
#include <zephyr/logging/log.h>

#include "buttons.h"
#include "events.h"
#include "stuck.h"

LOG_MODULE_REGISTER(watch_buttons, LOG_LEVEL_INF);

/* A probe of a stuck button: its input connected again, the pull-down against
 * the pin's few pF settles in well under a microsecond */
#define PROBE_SETTLE_US 10

/* The frame of the module carries the + of the cell: a press pulls the input
 * up against its pull-down (V2-22, the devicetree flags say so) */
static const struct gpio_dt_spec keys[BUTTON_COUNT] = {
	[BUTTON_LIGHT] = GPIO_DT_SPEC_GET(DT_NODELABEL(button_light), gpios),
	[BUTTON_MODE] = GPIO_DT_SPEC_GET(DT_NODELABEL(button_mode), gpios),
	[BUTTON_ALARM] = GPIO_DT_SPEC_GET(DT_NODELABEL(button_alarm), gpios),
};

static struct gpio_callback callbacks[BUTTON_COUNT];
static struct gesture_state machine;
static struct stuck stuck_state; /* the loop's own */
/* A take held down its whole length must never be taken for stuck: ALARM
 * hidden mid-take would leave its release and the stop press unseen */
BUILD_ASSERT(STUCK_HELD_MS >= CONFIG_CB91AI_WATCH_NOTE_MAX_S * 1000U + 60000U,
	     "a take this long would be taken for stuck: raise STUCK_HELD_MS");
static atomic_t pending;
/* When each button last moved, stamped in the interrupt: the loop may read
 * the levels late (a flash write), a click falls where it came (clicks.h) */
static atomic_t moved_at[BUTTON_COUNT];

/* False when the queue was full and the event dropped */
static bool wake_loop(void)
{
	/* Dropped: let go, the next edge posts again */
	if (atomic_cas(&pending, 0, 1) && !evt_post(EVT_BUTTON_EDGE, 0, 0, 0)) {
		atomic_set(&pending, 0);
		return false;
	}
	return true;
}

static void edge_isr(const struct device *port, struct gpio_callback *cb, uint32_t pins)
{
	const ptrdiff_t i = cb - callbacks;

	ARG_UNUSED(port);
	ARG_UNUSED(pins);
	if (i >= 0 && i < BUTTON_COUNT) {
		atomic_set(&moved_at[i], (atomic_val_t)k_uptime_get_32());
	}
	(void)wake_loop();
}

static void deadline_expired(struct k_timer *timer)
{
	/* No edge comes after a deadline (a button taken for stuck, or all
	 * three, makes none): dropped, it comes again a little later */
	if (!wake_loop()) {
		k_timer_start(timer, K_MSEC(100), K_NO_WAIT);
	}
}

static K_TIMER_DEFINE(deadline_timer, deadline_expired, NULL);

int buttons_init(void)
{
	static const struct gesture_cfg cfg = GESTURE_CFG_V1;
	int ret;

	gesture_init(&machine, &cfg, BUTTON_COUNT);
	stuck_init(&stuck_state, BUTTON_COUNT);
	for (size_t i = 0; i < BUTTON_COUNT; i++) {
		if (!gpio_is_ready_dt(&keys[i])) {
			return -ENODEV;
		}
		ret = gpio_pin_configure_dt(&keys[i], GPIO_INPUT);
		if (ret == 0) {
			gpio_init_callback(&callbacks[i], edge_isr, BIT(keys[i].pin));
			ret = gpio_add_callback(keys[i].port, &callbacks[i]);
		}
		if (ret == 0) {
			ret = gpio_pin_interrupt_configure_dt(&keys[i], GPIO_INT_EDGE_BOTH);
		}
		if (ret) {
			LOG_ERR("button %u: setup failed (%d)", (unsigned int)i, ret);
			return ret;
		}
	}
	/* A button already held counts from now */
	(void)wake_loop();
	return 0;
}

/* Taken for stuck (stuck.h): its input disconnected, pull-down included (the
 * driver gives the pin back its reset state), so that nothing runs through it */
static void let_go(size_t i)
{
	(void)gpio_pin_interrupt_configure_dt(&keys[i], GPIO_INT_DISABLE);
	(void)gpio_pin_configure(keys[i].port, keys[i].pin, GPIO_DISCONNECTED);
	LOG_WRN("button %u held %u s: taken for stuck, its pull-down released", (unsigned int)i,
		STUCK_HELD_MS / 1000U);
}

/* Connected again for a moment: still down, it is let go again; up, it is a
 * button like the others */
static void probe_due(uint32_t now)
{
	const uint8_t due = stuck_due(&stuck_state, now);

	for (size_t i = 0; i < BUTTON_COUNT; i++) {
		bool down;

		if ((due & BIT(i)) == 0) {
			continue;
		}
		(void)gpio_pin_configure_dt(&keys[i], GPIO_INPUT);
		k_busy_wait(PROBE_SETTLE_US);
		down = gpio_pin_get_dt(&keys[i]) > 0;
		stuck_probed(&stuck_state, (unsigned int)i, down, now);
		if (down) {
			(void)gpio_pin_configure(keys[i].port, keys[i].pin, GPIO_DISCONNECTED);
		} else {
			(void)gpio_pin_interrupt_configure_dt(&keys[i], GPIO_INT_EDGE_BOTH);
			LOG_INF("button %u let go", (unsigned int)i);
		}
	}
}

size_t buttons_process(struct gesture *out)
{
	const uint32_t now = k_uptime_get_32();
	uint32_t levels = 0;
	uint32_t wait = 0;
	uint32_t stuck_wait;
	uint8_t now_stuck;
	bool timed;
	size_t n;

	/* First: an edge from here on posts again, and is read below or next time */
	atomic_set(&pending, 0);
	probe_due(now);
	for (size_t i = 0; i < BUTTON_COUNT; i++) {
		if ((stuck_state.stuck & BIT(i)) == 0 && gpio_pin_get_dt(&keys[i]) > 0) {
			levels |= BIT(i);
		}
	}
	now_stuck = stuck_update(&stuck_state, (uint8_t)levels, now);
	for (size_t i = 0; i < BUTTON_COUNT; i++) {
		if (now_stuck & BIT(i)) {
			let_go(i);
		}
	}
	/* A stuck button is up for the gestures: its long press ends there,
	 * which does nothing that matters (ui.c), and the others work as ever */
	levels &= ~(uint32_t)stuck_state.stuck;
	n = gesture_update(&machine, levels, now, out);
	timed = gesture_next(&machine, now, &wait);
	if (stuck_next(&stuck_state, now, &stuck_wait) && (!timed || stuck_wait < wait)) {
		wait = stuck_wait;
		timed = true;
	}
	if (timed) {
		k_timer_start(&deadline_timer, K_MSEC(wait), K_NO_WAIT);
	} else {
		k_timer_stop(&deadline_timer);
	}
	return n;
}

uint32_t buttons_changed_at(enum button b)
{
	return (uint32_t)atomic_get(&moved_at[b]);
}

bool buttons_down(enum button b)
{
	return machine.b[b].raw;
}

uint8_t buttons_stuck(void)
{
	return stuck_state.stuck;
}
```

## src/buttons.h
```c
/*
 * Copyright (c) 2026 COBALT Technologies
 * SPDX-License-Identifier: Apache-2.0
 *
 * The three case buttons of the watch (lot D3). Their edges wake the event
 * loop; the loop reads the levels and runs the gesture machine of
 * lib/gesture.c, which says when to look again: nothing polls.
 */

#ifndef CB91AI_WATCH_BUTTONS_H
#define CB91AI_WATCH_BUTTONS_H

#include <stdbool.h>
#include <stddef.h>
#include <stdint.h>

#include "gesture.h"

/* Index of each button in the gestures, and bit in a chord mask */
enum button {
	BUTTON_LIGHT, /* L, top left */
	BUTTON_MODE,  /* C, bottom left */
	BUTTON_ALARM, /* A, bottom right: the voice */
	BUTTON_COUNT,
};

#define BUTTONS_RESET_CHORD (BIT(BUTTON_MODE) | BIT(BUTTON_ALARM))

/* Inputs and edge interrupts from the devicetree. 0 on success. */
int buttons_init(void);

/* On EVT_BUTTON_EDGE, from the event loop only: what the buttons did since the
 * last call, oldest first; `out` has room for GESTURE_OUT_MAX(BUTTON_COUNT). */
size_t buttons_process(struct gesture *out);

/* When button `b` last moved, in ms of uptime, stamped by its interrupt
 * (before the debounce), and whether it is down as the loop last read it:
 * where its click falls in a take (clicks.h) */
uint32_t buttons_changed_at(enum button b);
bool buttons_down(enum button b);

/* The buttons taken for stuck, a bit each (stuck.h), for the status line */
uint8_t buttons_stuck(void);

#endif /* CB91AI_WATCH_BUTTONS_H */
```

## src/cell.c
```c
/*
 * Copyright (c) 2026 COBALT Technologies
 * SPDX-License-Identifier: Apache-2.0
 *
 * What is left of the CR2016, see cell.h.
 */

#include <stddef.h>

#include "cell.h"

/* The Energizer curve read at these points (hours to 2.0 V: 1040), minus the
 * 60 mV of the watch's reading; percent: hours left over the 440 h from the
 * bend (600 h) to 2.0 V */
static const struct {
	int16_t mv;
	uint8_t percent;
} points[] = {
	{ 2840, 100 }, /* 2.90 V, 600 h: the end of the plateau */
	{ 2770, 77 },  /* 2.83 V, 700 h */
	{ 2680, 55 },  /* 2.74 V, 800 h */
	{ 2620, 43 },  /* 2.68 V, 850 h */
	{ 2520, 32 },  /* 2.58 V, 900 h */
	{ 2390, 20 },  /* 2.45 V, 950 h */
	{ 2190, 9 },   /* 2.25 V, 1000 h */
	{ 2000, 2 },   /* 2.06 V, 1030 h */
	{ 1940, 0 },   /* 2.00 V, 1040 h */
};

uint8_t cell_percent(int32_t mv)
{
	const size_t n = sizeof(points) / sizeof(points[0]);

	if (mv >= points[0].mv) {
		return points[0].percent;
	}
	for (size_t i = 1; i < n; i++) {
		if (mv >= points[i].mv) {
			const int32_t span_mv = points[i - 1].mv - points[i].mv;
			const int32_t span_pc = points[i - 1].percent - points[i].percent;

			/* Linear between two points, rounded to the nearest */
			return (uint8_t)(points[i].percent +
					 ((mv - points[i].mv) * span_pc + span_mv / 2) / span_mv);
		}
	}
	return 0;
}

uint8_t cell_percent_at(int32_t mv, int32_t temp_cc, bool known)
{
	if (!known) {
		return cell_percent(mv);
	}
	/* (21 degC - t) x 1 mV a degree, rounded to the nearest mV */
	const int32_t diff_cc = CELL_REF_CC - temp_cc;
	const int32_t shift = (diff_cc * CELL_MV_PER_C + (diff_cc >= 0 ? 50 : -50)) / 100;

	return cell_percent(mv + shift);
}
```

## src/cell.h
```c
/*
 * Copyright (c) 2026 COBALT Technologies
 * SPDX-License-Identifier: Apache-2.0
 *
 * What is left of the CR2016, from its voltage (EF-42, lot D5): the Battery
 * Service percentage and the HELLO of Cobalt Link. Pure logic, no Zephyr: the
 * host tests run it (firmware/tests/host).
 *
 * A lithium coin cell says little through its voltage: the discharge curve of
 * Energizer's CR2016 datasheet (30 kohm, 21 degC) stays on a
 * plateau at 2.93 V for more than half its life, then bends down to 2.0 V
 * (1040 h). On the plateau nothing tells how much is left: 100 %. Past the
 * bend (2.90 V, 600 h), the percentage is the part of the rest of the curve
 * still to come, down to 0 at 2.0 V. The watch reads its cell some 60 mV below
 * that curve (on 2026-09-26: 2.85 to 2.88 V at rest on the plateau), its own
 * load while it reads, and more as the cell ages: the table below is the
 * curve minus 60 mV, and errs on the low side at the end of life.
 *
 * Nothing depends on it in the watch, which behaves the same over the whole
 * range (2026-09-22): it only goes to the phone.
 */

#ifndef CB91AI_WATCH_CELL_H
#define CB91AI_WATCH_CELL_H

#include <stdbool.h>
#include <stdint.h>

/* The reading of the watch at rest, in mV, to 0..100 */
uint8_t cell_percent(int32_t mv);

/* The same at a temperature, in hundredths of a degree (known: false when the
 * thermometer has not read yet): the curve is the datasheet's at 21 degC, and a
 * lithium cell reads lower in the cold without being emptier
 * (2026-09-29). The voltage is brought to 21 degC first, at CELL_MV_PER_C a
 * degree: the slope of a watch's journal at rest, 20 to 35 degC (+0.95 mV,
 * the datasheet giving no other temperature), as the app does. */
#define CELL_REF_CC    2100
#define CELL_MV_PER_C  1
uint8_t cell_percent_at(int32_t mv, int32_t temp_cc, bool known);

#endif /* CB91AI_WATCH_CELL_H */
```

## src/clicks.c
```c
/*
 * Copyright (c) 2026 COBALT Technologies
 * SPDX-License-Identifier: Apache-2.0
 *
 * The clicks of the buttons in the frames of a take, see clicks.h. Pure C: the
 * host tests build this file as it is.
 */

#include "clicks.h"

void clicks_init(struct clicks *c, uint32_t deaf_first)
{
	*c = (struct clicks){ .deaf_until = deaf_first };
}

void clicks_block(struct clicks *c, uint32_t at_ms, uint32_t frames)
{
	/* The frames ended when the block came, or before: frame 0 started
	 * `frames` frames before that at the latest */
	const uint32_t t0 = at_ms - frames * CLICKS_FRAME_MS;

	if (!c->anchored || (int32_t)(t0 - c->t0_ms) < 0) {
		c->t0_ms = t0;
		c->anchored = true;
	}
}

bool clicks_frame(const struct clicks *c, uint32_t at_ms, uint32_t *frame)
{
	int32_t since;

	if (!c->anchored) {
		return false;
	}
	since = (int32_t)(at_ms - c->t0_ms);
	/* Before the first frame (the press that started the take, a bounce of
	 * it): the first frame */
	*frame = since < 0 ? 0U : (uint32_t)since / CLICKS_FRAME_MS;
	return true;
}

bool clicks_edge(struct clicks *c, uint32_t at_ms, bool down)
{
	const uint32_t before = down ? CLICKS_PRESS_BEFORE : CLICKS_RELEASE_BEFORE;
	const uint32_t after = down ? CLICKS_PRESS_AFTER : CLICKS_RELEASE_AFTER;
	uint32_t f;

	if (!clicks_frame(c, at_ms, &f)) {
		return false;
	}
	c->from[c->next] = f > before ? f - before : 0U;
	c->to[c->next] = f + after;
	c->next = (uint8_t)((c->next + 1U) % CLICKS_WINDOWS);
	return true;
}

bool clicks_listen(struct clicks *c, uint32_t at_ms)
{
	uint32_t f;

	if (!clicks_frame(c, at_ms, &f)) {
		return false;
	}
	if (f + CLICKS_RELEASE_AFTER < c->deaf_until) {
		c->deaf_until = f + CLICKS_RELEASE_AFTER;
	}
	return true;
}

bool clicks_deaf(const struct clicks *c, uint32_t frame)
{
	if (frame < c->deaf_until) {
		return true;
	}
	for (uint32_t i = 0; i < CLICKS_WINDOWS; i++) {
		if (frame >= c->from[i] && frame < c->to[i]) {
			return true;
		}
	}
	return false;
}
```

## src/clicks.h
```c
/*
 * Copyright (c) 2026 COBALT Technologies
 * SPDX-License-Identifier: Apache-2.0
 *
 * The clicks of the buttons in the frames of a take (lot E1, its finishing
 * touches of 2026-09-25). Through the case, a button is heard as loud as a
 * voice: a press from about 300 ms before its contact (the finger lands, then
 * pushes), a release for 100 to 200 ms after it (at the wrist, 2026-09-24).
 * The event loop knows when each edge came, in ms of uptime; the audio thread
 * knows when each block of the microphone came. This maps the one onto the
 * other, frame by frame, so that the voice detector does not take a click for
 * a word, and a note stopped by a press ends before the finger is heard.
 *
 * The frames are those of 10 ms of the take, from 0. Each block anchors the
 * map: its frames ended at most when it came, and the block that came the
 * soonest after its end gives the map (the thread may take a block late,
 * never early). Pure logic, tested on the PC (firmware/tests/host/test_clicks.c).
 */

#ifndef CB91AI_WATCH_CLICKS_H
#define CB91AI_WATCH_CLICKS_H

#include <stdbool.h>
#include <stdint.h>

#define CLICKS_FRAME_MS      10U
#define CLICKS_PRESS_BEFORE  30U /* frames deaf before the contact of a press */
#define CLICKS_PRESS_AFTER   10U /* and after it */
#define CLICKS_RELEASE_BEFORE 5U /* around a release */
#define CLICKS_RELEASE_AFTER 20U
#define CLICKS_WINDOWS       8U  /* the latest edges of a take */

struct clicks {
	bool anchored;
	uint32_t t0_ms;       /* uptime at the start of frame 0, the soonest seen */
	uint32_t deaf_until;  /* the first frames, deaf: until ALARM is released */
	uint32_t from[CLICKS_WINDOWS];
	uint32_t to[CLICKS_WINDOWS]; /* frames deaf around an edge, to excluded */
	uint8_t next;
};

/* A take starts: deaf for its first `deaf_first` frames, whatever comes */
void clicks_init(struct clicks *c, uint32_t deaf_first);

/* A block came at `at_ms`, and with it the frames up to `frames` (the count
 * of the take so far, this block included) */
void clicks_block(struct clicks *c, uint32_t at_ms, uint32_t frames);

/* The frame a time falls in: false before the first block, or before the take */
bool clicks_frame(const struct clicks *c, uint32_t at_ms, uint32_t *frame);

/* An edge of a button during the take, pressed (`down`) or released: the
 * frames around it made deaf. False when it falls outside the frames known. */
bool clicks_edge(struct clicks *c, uint32_t at_ms, bool down);

/* ALARM released after the latch: deaf until its click is over, no later
 * than the first frames set by clicks_init(). False before the first block:
 * the caller tries again with the next one. */
bool clicks_listen(struct clicks *c, uint32_t at_ms);

/* Whether the voice detector must not hear frame `frame` */
bool clicks_deaf(const struct clicks *c, uint32_t frame);

#endif /* CB91AI_WATCH_CLICKS_H */
```

## src/counters.c
```c
/*
 * Copyright (c) 2026 COBALT Technologies
 * SPDX-License-Identifier: Apache-2.0
 *
 * The boots and the watchdog bites, see counters.h.
 */

#include <zephyr/drivers/hwinfo.h>
#include <zephyr/kernel.h>
#include <zephyr/logging/log.h>
#include <zephyr/retention/retention.h>
#include <zephyr/settings/settings.h>

#include "counters.h"
#include "counts.h"

LOG_MODULE_REGISTER(watch_counters, LOG_LEVEL_INF);

#define SETTING_COUNTS "stats/counts"
/* Nothing written to the flash before the watch has run this long */
#define COUNTERS_QUIET_MS 60000

static const struct device *const retained = DEVICE_DT_GET(DT_NODELABEL(counters_retention));

static struct counts stored;
static bool stored_ok;
static struct counts now; /* the loop's own */
static bool dirty;

static int stats_settings_set(const char *name, size_t len, settings_read_cb read_cb, void *cb_arg)
{
	if (settings_name_steq(name, "counts", NULL) && len == sizeof(stored)) {
		stored_ok = read_cb(cb_arg, &stored, sizeof(stored)) == (ssize_t)sizeof(stored);
		return 0;
	}
	return -ENOENT;
}

SETTINGS_STATIC_HANDLER_DEFINE(cb91ai_stats, "stats", NULL, stats_settings_set, NULL, NULL);

void counters_boot(uint32_t reset_cause)
{
	struct counts kept = { 0 };
	const bool kept_ok = device_is_ready(retained) && retention_is_valid(retained) == 1 &&
			     retention_read(retained, 0, (uint8_t *)&kept, sizeof(kept)) == 0;

	(void)settings_load_subtree("stats");
	now = counts_boot(&kept, kept_ok, &stored, stored_ok, (reset_cause & RESET_WATCHDOG) != 0);
	if (device_is_ready(retained)) {
		(void)retention_write(retained, 0, (const uint8_t *)&now, sizeof(now));
	}
	dirty = true;
	LOG_INF("boot %u, %u watchdog bite(s)%s", (unsigned int)now.boots, (unsigned int)now.bites,
		(reset_cause & RESET_WATCHDOG) ? ", this one among them" : "");
}

void counters_keep(void)
{
	if (!dirty || k_uptime_get() < COUNTERS_QUIET_MS) {
		return;
	}
	if (settings_save_one(SETTING_COUNTS, &now, sizeof(now)) == 0) {
		dirty = false;
	}
}

uint16_t counters_boots(void)
{
	return now.boots;
}

uint16_t counters_bites(void)
{
	return now.bites;
}
```

## src/counters.h
```c
/*
 * Copyright (c) 2026 COBALT Technologies
 * SPDX-License-Identifier: Apache-2.0
 *
 * The boots and the watchdog bites of the watch (EF-72, EF-73), read by the
 * phone in the counters of Cobalt Link (key 0x10). Counted at once in the
 * retained RAM (counters_retention in the devicetree), so that a watch
 * rebooting in a loop, the very case to see, is counted too; kept in the
 * settings once the watch has run a minute, as nothing is written to the flash
 * early in a boot (on the cell). The reset of phase S keeps them,
 * as it keeps the quartz's correction: they belong to the watch.
 */

#ifndef CB91AI_WATCH_COUNTERS_H
#define CB91AI_WATCH_COUNTERS_H

#include <stdint.h>

/* The settings running: this boot counted, and its reset cause (hwinfo) */
void counters_boot(uint32_t reset_cause);

/* From the loop, now and then: into the settings, once past the first minute
 * and only when they changed */
void counters_keep(void);

uint16_t counters_boots(void);
uint16_t counters_bites(void);

#endif /* CB91AI_WATCH_COUNTERS_H */
```

## src/counts.c
```c
/*
 * Copyright (c) 2026 COBALT Technologies
 * SPDX-License-Identifier: Apache-2.0
 *
 * The boots and the watchdog bites, see counts.h.
 */

#include "counts.h"

static uint16_t larger(uint16_t a, bool a_ok, uint16_t b, bool b_ok)
{
	const uint16_t x = a_ok ? a : 0U;
	const uint16_t y = b_ok ? b : 0U;

	return x > y ? x : y;
}

static uint16_t plus_one(uint16_t n)
{
	return n == UINT16_MAX ? n : (uint16_t)(n + 1U);
}

struct counts counts_boot(const struct counts *retained, bool retained_ok,
			  const struct counts *stored, bool stored_ok, bool bitten)
{
	struct counts c = {
		.boots = larger(retained->boots, retained_ok, stored->boots, stored_ok),
		.bites = larger(retained->bites, retained_ok, stored->bites, stored_ok),
	};

	c.boots = plus_one(c.boots);
	if (bitten) {
		c.bites = plus_one(c.bites);
	}
	return c;
}
```

## src/counts.h
```c
/*
 * Copyright (c) 2026 COBALT Technologies
 * SPDX-License-Identifier: Apache-2.0
 *
 * The boots and the watchdog bites (EF-72, EF-73), the pure part of
 * counters.h: where this boot counts from. No Zephyr: the host tests run it
 * (firmware/tests/host).
 */

#ifndef CB91AI_WATCH_COUNTS_H
#define CB91AI_WATCH_COUNTS_H

#include <stdbool.h>
#include <stdint.h>

struct counts {
	uint16_t boots;
	uint16_t bites; /* watchdog bites */
};

/* The counts of this boot. The retained RAM survives a soft reset; a bite may
 * corrupt it (nRF52840 PS v1.11, reset behavior, p. 90), which its CRC tells
 * (retained_ok false). It holds the boots counted since the settings last kept
 * them; the settings survive a new cell. Each count is the larger of the two it has, then this
 * boot adds one, and one bite if it came from the watchdog, both stopping at
 * 65535 (u16 in Cobalt Link, key 0x10). */
struct counts counts_boot(const struct counts *retained, bool retained_ok,
			  const struct counts *stored, bool stored_ok, bool bitten);

#endif /* CB91AI_WATCH_COUNTS_H */
```

## src/daily.c
```c
/*
 * Copyright (c) 2026 COBALT Technologies
 * SPDX-License-Identifier: Apache-2.0
 *
 * When the watch calls the phone once a day, see daily.h. Pure C: the host
 * tests build this file as it is.
 */

#include "daily.h"

uint32_t daily_at(uint32_t call_s, uint32_t window_s, uint32_t link_end_s, uint32_t period_s)
{
	/* The silence starts at the end of the window of the last call, or at
	 * the end of the last link if that came later: any contact with the
	 * phone puts the call off by a whole period */
	const uint32_t window_end = call_s + window_s;
	const uint32_t silent_from = window_end > link_end_s ? window_end : link_end_s;

	return silent_from + period_s;
}

bool daily_due(uint32_t now_s, uint32_t call_s, uint32_t window_s, uint32_t link_end_s,
	       uint32_t period_s, bool linked, bool reachable)
{
	/* A watch no phone may meet (not paired, new or reset) keeps quiet: a
	 * press of ALARM calls for a pairing */
	return !linked && reachable &&
	       now_s >= daily_at(call_s, window_s, link_end_s, period_s);
}
```

## src/daily.h
```c
/*
 * Copyright (c) 2026 COBALT Technologies
 * SPDX-License-Identifier: Apache-2.0
 *
 * The daily call (the Cobalt Link specification): after a day without
 * any contact with the phone, counted from the end of the window of the last
 * call or from the end of the last link, whichever came later, the watch calls
 * it with the reason "daily" (3), so that the time is set again, the crystal
 * calibrated, the status and the journal read and the settings changed in the
 * app delivered. Not during a link, not without a phone to come (the bonded
 * one; any in the development build), and not while a note waits: the recall
 * calls for those already (recall.h). Unanswered, the next comes a day later.
 * Pure logic, tested on the PC (firmware/tests/host/test_daily.c); the event
 * loop asks it at every wake-up.
 */

#ifndef CB91AI_WATCH_DAILY_H
#define CB91AI_WATCH_DAILY_H

#include <stdbool.h>
#include <stdint.h>

/* A day, and the shortest period the development build may set (key 0x7E) */
#define DAILY_PERIOD_S     86400U
#define DAILY_PERIOD_MIN_S 60U

/* The uptime, in s, from which the daily call is due: `period_s` after the end
 * of the window of the last call (`window_s` long) or after the end of the last
 * link, whichever came later (0 for none since boot) */
uint32_t daily_at(uint32_t call_s, uint32_t window_s, uint32_t link_end_s, uint32_t period_s);

/* Whether the daily call is due at `now_s`, the notes aside: no link up
 * (`linked`), a phone to come (`reachable`), a day of silence. The caller
 * counts the notes last, when this says yes, and calls only when none waits. */
bool daily_due(uint32_t now_s, uint32_t call_s, uint32_t window_s, uint32_t link_end_s,
	       uint32_t period_s, bool linked, bool reachable);

#endif /* CB91AI_WATCH_DAILY_H */
```
